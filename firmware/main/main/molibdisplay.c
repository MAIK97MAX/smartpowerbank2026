/*-------------------------------------------------------------------------*\
| Datei:        molibdisplay.c
| Version:      1.0
| Projekt:      Display-Bibliothek fuer die MEGACARD V5.5
| Beschreibung: Bibliotheksfunktionen (Implementierung)
| Schaltung:    MEGACARD V5.5
| Autor:        D.I. Leopold Moosbrugger
| Erstellung:   3.3.2022
|
| Aenderung:
\*-------------------------------------------------------------------------*/
#define F_CPU 8000000UL

#include <avr/io.h>
#include <avr/pgmspace.h>
#include <stdio.h>
#include <stdarg.h>
#include <util/delay.h>
#include "molibdisplay.h" // Schnittstellendefinitionen


// Sevice Bereich SW-I2C Schnittstelle für das Display------------------------------


#ifdef TWI_S_FAST
   // Pause TWI 400kHz / I2C Fast 
   // 1us
   #define TWI_S_DELAY1() _delay_us(0.7)
   // 2us
   #define TWI_S_DELAY2() _delay_us(1.5)
#else
   // Pause TWI 100kHz / I2C Standard
   // 1us
   #define TWI_S_DELAY1() _delay_us(5.0)
   // 2us
   #define TWI_S_DELAY2() _delay_us(5.0)
#endif

#define P_SCL_LIN (1<<PSCL_TWI_S)
#define P_SDA_LIN (1<<PSDA_TWI_S)


// Definitionen fuer die Tackt- und die Datenleitung
// Open Drain
//    Low  => DDR->Ausgang, PORT->Low (0)
//    High => DDR->Eingang, PORT->kein PU (0) 
#define SDA_PSEC  (PRT_TWI_S &= ~P_SDA_LIN)
#define SDA_HIGH  (DDR_TWI_S &= ~P_SDA_LIN)
#define SDA_LOW   (DDR_TWI_S |=  P_SDA_LIN)
#define SDA_IN    (PIN_TWI_S & P_SDA_LIN)

//#define SCL_PSEC  (PRT_TWI_S &= ~P_SCL_LIN)
//#define SCL_HIGH  (DDR_TWI_S &= ~P_SCL_LIN)
//#define SCL_LOW   (DDR_TWI_S |=  P_SCL_LIN)
//#define SCL_IN    (PIN_TWI_S & P_SCL_LIN)


// Definitionen fuer die Tackt- und die Datenleitung
// Aktive Leitunge (Testbetrieb ohne Baustein)
//    Low  => DDR->Ausgang, PORT->Low (0)
//    High => DDR->Ausgang, PORT->High (1)
//#define SDA_PSEC  (DDR_TWI_S |=  P_SDA_LIN)
//#define SDA_HIGH  (PRT_TWI_S |=  P_SDA_LIN)
//#define SDA_LOW   (PRT_TWI_S &= ~P_SDA_LIN)
//#define SDA_IN    (PIN_TWI_S & P_SDA_LIN)

#define SCL_PSEC  (DDR_TWI_S |=  P_SCL_LIN)
#define SCL_HIGH  (PRT_TWI_S |=  P_SCL_LIN)
#define SCL_LOW   (PRT_TWI_S &= ~P_SCL_LIN)
#define SCL_IN    (PIN_TWI_S & P_SCL_LIN)


// Init TWI
void twi_s_init(void)
{
/* SCL XXX/''''
   SDA XX/'''''
*/

   SDA_HIGH; // SDA_HIGH;
   SDA_PSEC;
   SCL_HIGH; // SCL_HIGH;
   SCL_PSEC;
}

// Start TWI
uint8_t twi_s_start(uint8_t address)
{
/* SCL ''''\...
   SDA '\......
*/
   SDA_PSEC;
   SCL_PSEC;
   SDA_LOW; TWI_S_DELAY2();
   SCL_LOW; TWI_S_DELAY2();
   
   return twi_s_write(address);
}

uint8_t twi_s_rep_start(uint8_t address)
{
	// Nach twi_s_write() ist SCL noch LOW.
	// Für Repeated Start: SDA loslassen, SCL HIGH,
	// dann SDA bei HIGH auf LOW ziehen.

	SDA_PSEC;
	SCL_PSEC;

	SDA_HIGH;
	SCL_HIGH;
	TWI_S_DELAY2();

	SDA_LOW;
	TWI_S_DELAY2();

	SCL_LOW;
	TWI_S_DELAY2();

	return twi_s_write(address);
}

// Stop TWI
void twi_s_stop(void)
{
/* SCL ..../''''''
   SDA '\....../''
*/   
   SDA_PSEC;
   SCL_PSEC;
   SDA_LOW;  TWI_S_DELAY2();
   SCL_HIGH; TWI_S_DELAY2();
   SDA_HIGH; TWI_S_DELAY2();
}

// TWI schreiben
uint8_t twi_s_write(uint8_t data)
{
   uint8_t i;
   uint8_t hlp;
   uint8_t t;

   SDA_PSEC;
   SCL_PSEC;
  
/* SCL .../'0'\../'1'\../'2'\../'3'\../'4'\../'5'\../'6'\../'7'\../'A\
   SDA 'X======X======X======X======X======X======X======X======/'''''
*/  
   for (i=0;i<8;i++)
   {  // 8 Bit ausgeben
      if ((data & (1<<7)) != 0)
         SDA_HIGH; // wenn Bit gesetzt
      else
         SDA_LOW;  // wenn Bit nicht gesetzt

      data <<= 1;  // Bit schieben, 7 bis 0
      TWI_S_DELAY1();
      SCL_HIGH;
	  t = 255; while ((SCL_IN == 0) && (--t));
      TWI_S_DELAY2();
      SCL_LOW;
   }

   SDA_HIGH;
   TWI_S_DELAY1();
   SCL_HIGH;
   t = 255; while ((SCL_IN == 0) && (--t));
   TWI_S_DELAY1();

   if (SDA_IN == 0) // Testen SDA auf Acknowledge low
      hlp = ACK;    // Flag Ack setzen
   else
      hlp = NACK;   // sonst Flag Ack loeschen

   SCL_LOW;
   
   return hlp;
}

// TWI Byte lesen

uint8_t twi_s_read(uint8_t ack)
{
   uint8_t data = 0;
   uint8_t i;
   uint8_t t;

   SDA_PSEC;
   SCL_PSEC;

/* SCL ./'0\../'1\../'2\../'3\../'4\../'5\../'6\../'7\../''\.
   SDA ===D=====D=====D=====D=====D=====D=====D=====D=A=====/
*/
   for (i=0;i<8;i++)
   {  // 8 Bit ausgeben
      data <<= 1;			// Bit schieben, 7 bis 0
      TWI_S_DELAY1();
      SCL_HIGH;
	  t = 255; while ((SCL_IN == 0) && (--t));
      TWI_S_DELAY1();
      if (SDA_IN != 0) // Testen SDA auf high
         data |= 1;    // wenn high, Bit 0 setzen
      SCL_LOW;
   }

   if (ack)
      SDA_LOW;  // Acknowledge
   else
      SDA_HIGH;  // No Acknowledge
   
   TWI_S_DELAY1();
   SCL_HIGH;
   t = 255; while ((SCL_IN == 0) && (--t));
   TWI_S_DELAY2();
   SCL_LOW;
   SDA_HIGH;

   return data;  // Daten zurückgeben
}

void bq_bus_reset(void)
{
	uint8_t i;
	
	// clock out up to 9 pulses to release a stuck SDA
	DDR_TWI_S  |=  P_SCL_LIN;   // SCL output
	DDR_TWI_S  &= ~P_SDA_LIN;   // SDA input
	PRT_TWI_S  &= ~P_SCL_LIN;

	for (i = 0; i < 9; i++)
	{
		PRT_TWI_S |=  P_SCL_LIN;
		_delay_us(5);
		PRT_TWI_S &= ~P_SCL_LIN;
		_delay_us(5);
	}

	// issue a stop
	DDR_TWI_S |= P_SDA_LIN;
	_delay_us(5);
	PRT_TWI_S |= P_SCL_LIN;
	_delay_us(5);
	DDR_TWI_S &= ~P_SDA_LIN;
	_delay_us(5);
}

// Sevice Bereich SW-I2C Schnittstelle für das Display------------------------------

// Zeichnesatz-Code-----------------------------------------------------------------
// Auswahl des Zeichensatzes
//#define FONT_7x8
#define FONT_5x8

#if defined (FONT_7x8)
// erstes Zeichen, letztes Zeichen
// Fontbreite, Fonthoehe, Fontspacing
FontParam_t fontParam = {32, 129, 7, 8, 1};

const uint8_t fontData[] PROGMEM = {
	0x00, 0x00, 0x00, 0x00, 0x00, 0x00, 0x00,  // ' '  32
	0x00, 0x06, 0x5F, 0x5F, 0x06, 0x00, 0x00,  // '!'  33
	0x00, 0x07, 0x07, 0x00, 0x07, 0x07, 0x00,  // '"'  34
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	0xFF, 0xFF, 0x00, 0xC0, 0xC0, 0xC0, 0xC0   // HTL L 129
};

#elif defined (FONT_5x8)

// erstes Zeichen, letztes Zeichen
// Fontbreite, Fonthoehe, Fontspacing
FontParam_t fontParam = {32, 127, 5, 8, 2};

const unsigned char fontData[] PROGMEM =
{
	0x00, 0x00, 0x00, 0x00, 0x00,      // Code for char
	0x00, 0x00, 0x5F, 0x00, 0x00,      // Code for char !
	0x00, 0x07, 0x00, 0x07, 0x00,      // Code for char "
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	0x00, 0x7F, 0x41, 0x7F, 0x00       // Code for char 
};

#else
#    warning "Font type not defined"
#endif



// Zeichnesatz-Code-----------------------------------------------------------------


// Lokale Makros
#define OLED_CTRL_BYTE_CMD  0x80 // 0b1000 0000
#define OLED_CTRL_BYTE_DATA 0x40 // 0b0100 0000
#define OLED_DEV_ADDR 0x78       // 0b0111 1000

#define OLED_PAGES 8
#define OLED_PIXEL_X 128
#define OLED_PIXEL_Y 64

#define DISP_LINES (OLED_PIXEL_Y/fontParam.height)
#define DISP_COLS (OLED_PIXEL_X/(fontParam.width+fontParam.spacing))

#define  OLED_SEND_CMD(value)  {twi_s_write(OLED_CTRL_BYTE_CMD); twi_s_write((value));}

// Modullokale Variablen
static uint8_t d_offset = 0;

// Display initialisieren und einschalten
void display_init(void)
{
	// Initialisierung der SW-I2C Schnittstelle
	twi_s_init();
	
	// Initialisierungssequenzen senden
	// Siehe Application Note [SOLOMON SYSTECH]
	// http://www.solomon-systech.com

	twi_s_start(OLED_DEV_ADDR);
	OLED_SEND_CMD(0xA8); // Set Mux Ratio
	OLED_SEND_CMD(0x3F); // S32 (R)

	OLED_SEND_CMD(0xD3); // Set Display offset
	OLED_SEND_CMD(0x00); // S33 (R)

	OLED_SEND_CMD(0x40); // Set Segment Start Line S32 (R)

	OLED_SEND_CMD(0xA0); // Set Segment re-map S32 (R)

	OLED_SEND_CMD(0xC0); // Set COM Output Scan Direction S32 (R)

	OLED_SEND_CMD(0xDA); // Set COM Pins hardware configuration
	OLED_SEND_CMD(0x12); // S33 (R)

	OLED_SEND_CMD(0x81); // Set Contrast Control
	OLED_SEND_CMD(0x7F); // S27 (R)

	OLED_SEND_CMD(0xA4); // Disable Entre Display On S27 (R)

	OLED_SEND_CMD(0xA6); // Set Normal Display S27 (R)

	OLED_SEND_CMD(0xD5); // Set Osc Frequency
	OLED_SEND_CMD(0x80); // S33 (R)

	OLED_SEND_CMD(0x20); // Page addressing Mode
	OLED_SEND_CMD(0x02); // S31 (R)

	OLED_SEND_CMD(0x8D); // Enable charge pump regulator
	OLED_SEND_CMD(0x14); // during display on 7.5V S34 (R)
	twi_s_stop();

	display_clear();
	
	display_printf_pos(0,3,"HTLR OLED Display\n");
	display_printf_pos(0,4,"%u Zeichen",display_chars());
	display_printf_pos(0,5,"%u Zeilen",display_lines());

	
	// Modullokale Variablen initialisieren
	d_offset = 0;
		
	twi_s_start(OLED_DEV_ADDR);
	OLED_SEND_CMD(0xAF); // Display ON S27
	twi_s_stop();	
}

// Informationsfunktionen zur Anzeige
uint8_t display_lines (void)
{
	return DISP_LINES;
}

uint8_t display_chars (void)
{
	return DISP_COLS;
}

uint8_t display_char_first (void)
{
	return fontParam.char_first;
}

uint8_t display_char_last (void)
{
	return fontParam.char_last;
}

// Anzeigefunktionen (Implementierung)
void display_scroll_up (void)
{
	uint8_t ic;

	// oberste Zeile loeschen
	display_pos(0, 0);

	twi_s_start(OLED_DEV_ADDR);
	twi_s_write(OLED_CTRL_BYTE_DATA);
	// gesamte Page loeschen
	for(ic=0; ic<OLED_PIXEL_X; ic++)
	{
		twi_s_write(0x00);
	}
	twi_s_stop();

	d_offset += 1;
	if (d_offset >= DISP_LINES)
	d_offset -= DISP_LINES;

	twi_s_start(OLED_DEV_ADDR);
	OLED_SEND_CMD(0xD3); // Set Display offset
	OLED_SEND_CMD(d_offset<<3); // S33
	twi_s_stop();
}

void display_scroll_down (void)
{
	uint8_t ic;

	// unterste Zeile loeschen
	display_pos(0, DISP_LINES-1);

	twi_s_start(OLED_DEV_ADDR);
	twi_s_write(OLED_CTRL_BYTE_DATA);
	// gesamte Page loeschen
	for(ic=0; ic<OLED_PIXEL_X; ic++)
	{
		twi_s_write(0x00);
	}
	twi_s_stop();

	if (d_offset > 0)
	{
		d_offset--;
	} else
	{
		d_offset = DISP_LINES - 1;
	}

	twi_s_start(OLED_DEV_ADDR);
	OLED_SEND_CMD(0xD3); // Set Display offset
	OLED_SEND_CMD(d_offset<<3); // S33
	twi_s_stop();
}
// Setzt den Cursor an eine beliebige Position im Display
// Bei Ueberschreiten der Limite (DISP_LINES, DISP_COLS) bleibt
// der Cursor unveraendert. (Zaehler beginnt bei 0)
// x-Position von links nach rechts, y-Position von oben nach unten
void display_pos(uint8_t col, uint8_t row)
{
	uint8_t pixel_col;

	// ungueltige Parameter abfangen
	if ((row < DISP_LINES) && (col < DISP_COLS))
	{
		pixel_col = col * (fontParam.width+fontParam.spacing);

		// Zeilenadresse anpassen
		row += d_offset;
		if (row >= DISP_LINES)
		row -= DISP_LINES;

		twi_s_start(OLED_DEV_ADDR);
		// Seitenadresse setzen
		OLED_SEND_CMD((0b10110000 | row));

		// unteres Nibble der Col-Addresse ((col*8) & 0x0F)
		OLED_SEND_CMD(pixel_col & 0x0F);

		// oberes Nibble der Col-Addresse ((col*8/16) & 0x0F)
		OLED_SEND_CMD(0x10 | ((pixel_col>>4) & 0x0F));

		twi_s_stop();
	}
}

// Loescht den Inhalt des Displays und setzt den Cursor oben links (Home)
void display_clear(void)
{
	uint8_t ip, ic;
	
	// Alle Speicher Pages loeschen
	for(ip=0; ip<OLED_PAGES; ip++)
	{
		display_pos(0, ip);

		twi_s_start(OLED_DEV_ADDR);
		twi_s_write(OLED_CTRL_BYTE_DATA);
		// gesamte Page loeschen
		for(ic=0; ic<OLED_PIXEL_X; ic++)
		{
			twi_s_write(0x00);
		}
		twi_s_stop();
	}

	// Cursor in Position 0, 0
	display_pos(0, 0);
}

// Ausgabe eines Zeichens an der aktuellen Position
void display_char (uint8_t c)
{
	uint8_t cnt;
	uint16_t f_index;
	
	// Ungueltige Zeichen abfangen (erstes Zeichen imZeichensatz)
	if ((c < fontParam.char_first) || (c > fontParam.char_last))
	c = fontParam.char_first;
	
	// Index im FontData-Arry berechnen
	f_index = (c - fontParam.char_first) * fontParam.width;

	// write zero to next GDRAM Position
	twi_s_start(OLED_DEV_ADDR);
	twi_s_write(OLED_CTRL_BYTE_DATA);

	// Display character c at current position
	for (cnt=0; cnt<fontParam.width; cnt++)
	{
		twi_s_write(pgm_read_byte(&fontData[f_index++]));
	}

	// Spacing ausgeben
	for (cnt=0; cnt<fontParam.spacing; cnt++)
	{
		twi_s_write(0);
	}

	twi_s_stop();
}

void display_string (char *line)
{
	while (*line)
	display_char(*line++);
}

void display_string_pos (uint8_t posx, uint8_t posy, char *line)
{
	display_pos(posx, posy);
	display_string(line);
}

int8_t  display_printf(const char *fmt, ...)
{
	char buf[25];
	int8_t c_count;

	va_list args;
	va_start(args, fmt);
	c_count = vsnprintf(buf, sizeof buf, fmt, args);
	va_end(args);
	
	if (c_count >= 0)
	display_string(buf);
	return c_count;
}

int8_t display_printf_pos(uint8_t posx, uint8_t posy, const char *fmt, ...)
{
	char buf[25];
	int8_t c_count;
	
	va_list args;
	va_start(args, fmt);
	c_count = vsnprintf(buf, sizeof buf, fmt, args);
	va_end(args);
	
	if (c_count >= 0)
	display_string_pos(posx, posy, buf);
	return c_count;
}

void display_pixel_byte (uint8_t pcol, uint8_t prow, uint8_t pbyte)
{
	if ((prow < OLED_PIXEL_Y) && (pcol < OLED_PIXEL_X))
	{
		prow >>= 3; // prow / 8

		twi_s_start(OLED_DEV_ADDR);
		// Seitenadresse setzen
		OLED_SEND_CMD((0b10110000 | prow));
		// unteres Nibble der Col-Addresse ((col*8) & 0x0F)
		OLED_SEND_CMD(pcol & 0x0F);
		// oberes Nibble der Col-Addresse ((col*8/16) & 0x0F)
		OLED_SEND_CMD(0x10 | ((pcol>>4) & 0x0F));
		twi_s_stop();
		
		twi_s_start(OLED_DEV_ADDR);
		twi_s_write(OLED_CTRL_BYTE_DATA);
		twi_s_write(pbyte);
		twi_s_stop();
	}
}